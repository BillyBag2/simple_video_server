## sdkconfig.defaults.esp32p4
```kconfig
# OV5647 Sensor support
CONFIG_CAMERA_OV5647=y
CONFIG_CAMERA_OV5647_AUTO_DETECT_MIPI_INTERFACE_SENSOR=y
CONFIG_CAMERA_OV5647_MIPI_RAW8_800X800_50FPS=y
CONFIG_CAMERA_OV5647_MIPI_IF_FORMAT_INDEX_DEFAULT=2
CONFIG_CAMERA_OV5647_CSI_LINESYNC_ENABLE=y
CONFIG_CAMERA_OV5647_DEFAULT_IPA_JSON_CONFIGURATION_FILE=y

CONFIG_IDF_EXPERIMENTAL_FEATURES=y

CONFIG_SPIRAM=y
CONFIG_SPIRAM_SPEED_200M=y

CONFIG_ESP_VIDEO_ENABLE_ISP_PIPELINE_CONTROLLER=y

# Board selection
# CONFIG_EXAMPLE_SELECT_ESP32P4_FUNCTION_EV_BOARD_V1_5=y

################# WS_ESP32-P4-WIFI6
# CONFIG_EXAMPLE_SELECT_ESP32P4_FUNCTION_WS_BOARD_WIFI6=y


##################  JC-ESP32-P4-M3-DEV
#CONFIG_EXAMPLE_SELECT_ESP32P4_FUNCTION_JC_ESP32_P4_MC_DEV=y

## The boot messages told me enable BOYA_CHIP
#CONFIG_SPI_FLASH_SUPPORT_BOYA_CHIP=y

## 16MB FLASH SIZE
#CONFIG_ESPTOOLPY_FLASHSIZE_16MB=y
#CONFIG_ESPTOOLPY_FLASHSIZE="16MB"

################## WS-ESP32-P4-ETH
CONFIG_EXAMPLE_SELECT_ESP32P4_FUNCTION_WS_ESP32_P4_ETH=y

## 32MB FLASH SIZE
CONFIG_ESPTOOLPY_FLASHSIZE_32MB=y
CONFIG_ESPTOOLPY_FLASHSIZE="32MB"
```
